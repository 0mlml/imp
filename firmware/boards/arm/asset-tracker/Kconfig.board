## firmware/boards/arm/asset-tracker/Kconfig.board
```kconfig
config BOARD_ASSET-TRACKER
	bool "Custom Board auto generated by nRF Connect for VS Code"
	depends on SOC_NRF52840_QFAA
```

## firmware/boards/arm/asset-tracker/Kconfig.defconfig
```kconfig
if BOARD_ASSET-TRACKER

config BOARD
	default "asset-tracker"

config BT_CTLR
	default BT

endif # BOARD_ASSET-TRACKER
```

## firmware/boards/arm/asset-tracker/asset-tracker_defconfig
```kconfig
CONFIG_SOC_SERIES_NRF52X=y
CONFIG_SOC_NRF52840_QFAA=y
CONFIG_BOARD_ASSET-TRACKER=y

CONFIG_ARM_MPU=y
CONFIG_HW_STACK_PROTECTION=y

CONFIG_PINCTRL=y
```
